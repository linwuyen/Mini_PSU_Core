/**
 * These arguments were used when this file was generated. They will be automatically applied on subsequent loads
 * via the GUI or CLI. Run CLI with '--help' for additional information on how to override these arguments.
 * @cliArgs --device "F2838x" --part "F2838x_176pin" --package "176pin" --context "CPU2" --product "C2000WARE@6.00.01.00"
 * @v2CliArgs --device "TMS320F28388D" --package "176pin" --context "CPU2" --product "C2000WARE@6.00.01.00"
 * @versions {"tool":"1.27.1+4634"}
 */

/**
 * Import the modules used in this configuration.
 */
const device_support = scripting.addModule("/driverlib/device_support.js");
